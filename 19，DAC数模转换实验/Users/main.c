/**************************************************************************************
实验名称：	DAC模数转换实验
实验现象：	DAC(PWM)模块上的指示灯DA1呈呼吸灯效果，由暗变亮再由亮变暗
实验单片机：普中A2			
注意事项：																		  
***************************************************************************************/

#include "public.h"
#include  "pwm.h"


int main(void)
{
	uint_8 dir = 0;		//默认为0
	uint_8 duty = 0;

	PWM_Init(0XFF,0XF6,100,0);		//定时时间为0.01ms，PWM周期是100*0.01ms=1ms，占空比为0%

	while(1)
	{
		if(dir == 0)		//当dir为递增方向
		{
			duty++;			//占空比递增
			if(duty == 70)
				dir = 1;		//当到达一定值切换方向，占空比到达70左右再递增，肉眼无法分辨亮度变化
		}
		else
		{
			duty--;
			if(duty == 0)
				dir = 0;			//当到达一定值切换方向	
		}
		PWM_Set_Duty_Cycle(duty);	//设置占空比
		Delay_ms(1);				//短暂延时，让呼吸灯有一个流畅的效果			
	}
}



